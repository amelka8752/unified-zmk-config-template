## boards/shields/Kconfig.defconfig
```kconfig
if SHIELD_KBD_CENTER

config ZMK_KEYBOARD_NAME
    default "kbd"

config ZMK_SPLIT_ROLE_CENTRAL
    default y

endif

if SHIELD_KBD_LEFT || SHIELD_KBD_RIGHT || SHIELD_KBD_CENTER

config ZMK_SPLIT
    default y

endif
```

## config/boards/shields/kbd/Kconfig.shield
```kconfig
config SHIELD_KBD_LEFT
    def_bool $(shields_list_contains,kbd_left)

config SHIELD_KBD_CENTER
    def_bool $(shields_list_contains,kbd_center)

config SHIELD_KBD_RIGHT
    def_bool $(shields_list_contains,kbd_right)
```
